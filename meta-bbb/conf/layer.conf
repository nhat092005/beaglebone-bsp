## meta-bbb/conf/layer.conf
```bitbake
# BeagleBone Black BSP layer — Yocto Project Kirkstone (4.0.x)

BBPATH .= ":${LAYERDIR}"
BBFILES += "${LAYERDIR}/recipes-*/*/*.bb \
            ${LAYERDIR}/recipes-*/*/*.bbappend"

BBFILE_COLLECTIONS += "meta-bbb"
BBFILE_PATTERN_meta-bbb = "^${LAYERDIR}/"
BBFILE_PRIORITY_meta-bbb = "10"

LAYERVERSION_meta-bbb = "1"
LAYERDEPENDS_meta-bbb = "core openembedded-layer"
LAYERSERIES_COMPAT_meta-bbb = "kirkstone"
```

## u-boot/configs/am335x_boneblack_custom_defconfig
```kconfig
# BeagleBone Black custom defconfig
# Based on am335x_evm_defconfig (U-Boot v2021.10)
# Customizations: BOOTDELAY=1, DHCP/TFTP enabled, reduced command set

CONFIG_ARM=y
CONFIG_ARCH_OMAP2PLUS=y
CONFIG_TI_COMMON_CMD_OPTIONS=y
CONFIG_AM33XX=y
CONFIG_TARGET_AM335X_EVM=y
CONFIG_DEFAULT_DEVICE_TREE="am335x-boneblack"
CONFIG_SPL=y
# CONFIG_SYS_MALLOC_F is not set
CONFIG_SPL_AM33XX_ENABLE_RTC32K_OSC=y
CONFIG_DISTRO_DEFAULTS=y

# Boot configuration
CONFIG_BOOTDELAY=1
CONFIG_USE_BOOTARGS=y
CONFIG_BOOTARGS="console=ttyO0,115200n8 root=/dev/mmcblk0p2 rw rootfstype=ext4 rootwait"

# Networking — TFTP dev workflow
CONFIG_CMD_DHCP=y
CONFIG_CMD_TFTP=y
CONFIG_CMD_NET=y

# Network defaults for dev
CONFIG_USE_SERVERIP=y
CONFIG_SERVERIP="192.168.1.1"
CONFIG_USE_IPADDR=y
CONFIG_IPADDR="192.168.1.100"

# Core commands
CONFIG_CMD_BOOTM=y
CONFIG_CMD_BOOTZ=y
CONFIG_CMD_ENV=y
CONFIG_CMD_FAT=y
CONFIG_CMD_EXT4=y
CONFIG_CMD_FS_GENERIC=y
CONFIG_CMD_MMC=y
CONFIG_CMD_GPIO=y
CONFIG_CMD_I2C=y
CONFIG_CMD_LOADB=y
CONFIG_CMD_LOADS=y
CONFIG_CMD_MEMORY=y
CONFIG_CMD_MISC=y
CONFIG_CMD_SPI=y
CONFIG_CMD_USB=y
CONFIG_CMD_PING=y

# Disable unused commands to reduce image size
# CONFIG_CMD_FPGA is not set
# CONFIG_CMD_FLASH is not set
# CONFIG_CMD_IMLS is not set
# CONFIG_CMD_NAND is not set
# CONFIG_CMD_ONENAND is not set
# CONFIG_CMD_MTDPARTS is not set

# Storage
CONFIG_MMC=y
CONFIG_OMAP_HSMMC=y
CONFIG_FAT_WRITE=y

# Serial
CONFIG_SYS_NS16550=y

# Misc
CONFIG_OF_CONTROL=y
CONFIG_OF_BOARD_SETUP=y
CONFIG_ENV_IS_IN_FAT=y
CONFIG_ENV_FAT_INTERFACE="mmc"
CONFIG_ENV_FAT_DEVICE_AND_PART="0:1"
CONFIG_SPL_OF_CONTROL=y
CONFIG_TIMESTAMP=y
CONFIG_LZO=y
```
